## config/boards/shields/Kconfig.defconfig
```kconfig
if SHIELD_COSMOS_LEFT

config ZMK_KEYBOARD_NAME
    default "Cosmos 5x6 - L"

config ZMK_SPLIT_ROLE_CENTRAL
    default y

endif

if SHIELD_COSMOS_RIGHT

config ZMK_KEYBOARD_NAME
    default "Cosmos 5x6 - R"

endif

if SHIELD_COSMOS_LEFT || SHIELD_COSMOS_RIGHT

config ZMK_SPLIT
    default y

endif
```

## config/boards/shields/Kconfig.shield
```kconfig
config SHIELD_COSMOS_LEFT
    def_bool $(shields_list_contains, cosmos-5x6_left)

config SHIELD_COSMOS_RIGHT
    def_bool $(shields_list_contains, cosmos-5x6_right)
```

## config/boards/shields/cosmos-5x6/Kconfig.defconfig
```kconfig
if SHIELD_COSMOS-5x6_LEFT

config ZMK_KEYBOARD_NAME
    default "Cosmos 5x6 - L"

config ZMK_SPLIT_ROLE_CENTRAL
    default y

endif

if SHIELD_COSMOS-5x6_RIGHT

config ZMK_KEYBOARD_NAME
    default "Cosmos 5x6 - R"

endif

if SHIELD_COSMOS-5x6_LEFT || SHIELD_COSMOS-5x6_RIGHT

config ZMK_SPLIT
    default y

endif
```

## config/boards/shields/cosmos/Kconfig.defconfig
```kconfig
if SHIELD_COS_LEFT

    config ZMK_KEYBOARD_NAME
        default "cosmos"

    config ZMK_SPLIT_ROLE_CENTRAL
        default y

endif

if SHIELD_COS_LEFT || SHIELD_COS_RIGHT

    config ZMK_SPLIT
        default y

endif
```

## config/boards/shields/cosmos/Kconfig.shield
```kconfig
config SHIELD_COS_LEFT
    def_bool $(shields_list_contains, cosmos_left)

config SHIELD_COS_RIGHT
    def_bool $(shields_list_contains, cosmos_right)
```
